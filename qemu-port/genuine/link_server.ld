/* Genuine-source server process: same loader-visible layout as an EXE (the
   port has no separate server UID1 path yet); the .genuine_exp pad carries a
   .def-derived export directory when the server exports its IPC interface. */
OUTPUT_FORMAT(elf32-i386)
ENTRY(_start)
SECTIONS
{
    . = 0x00400000;
    .text : { *(.text.start) *(.text .text.*) *(.rodata .rodata.*) *(.genuine_exp) }
    . = 0x00500000;
    .data : { *(.data .data.*) }
    .bss : { *(.bss .bss.*) *(COMMON) }
    /DISCARD/ : { *(.comment) *(.note*) *(.eh_frame*) *(.gcc_except_table*) }
}
